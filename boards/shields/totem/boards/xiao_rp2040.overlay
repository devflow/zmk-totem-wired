&pio0 {
    status = "okay";

    pio0_uart: serial {
        status = "okay";
        compatible = "raspberrypi,pico-uart-pio";
        pinctrl-0 = <&pio0_uart_default>;
        pinctrl-names = "default";
        current-speed = <115200>;
    };
};
